## boards/arm/stm32h7/stm32h747i-disco/Kconfig
```kconfig
#
# For a description of the syntax of this configuration file,
# see the file kconfig-language.txt in the NuttX tools repository.
#

if ARCH_BOARD_STM32H747I_DISCO

config STM32H747I_DISCO_LCD
	bool "MB1166 DSI display"
	default n
	depends on VIDEO_FB && STM32_FMC
	select STM32_DSIHOST
	select STM32_LTDC
	select MIPI_DSI
	---help---
		Framebuffer driver for the 4" 800x480 display of the MB1166
		display board, connected over two DSI lanes in video mode.  The
		OTM8009A and NT35510 controllers are detected at runtime.  The
		framebuffer is in the SDRAM, at CONFIG_STM32_LTDC_FB_BASE.

config STM32H747I_DISCO_TOUCHSCREEN_SWAPXY
	bool "Swap the touch screen X and Y"
	default n
	depends on INPUT_FT5X06
	---help---
		The FT6x06 touch controller of the MB1166 display board reports
		landscape coordinates, like the display.  Swap X and Y if it does
		not match.

endif # ARCH_BOARD_STM32H747I_DISCO
```
